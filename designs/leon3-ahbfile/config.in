## designs/leon3-ahbfile/config.in
```kconfig
# LEON3 configuration for ahbfile example design

mainmenu_name "LEON3MP Design Configuration"

mainmenu_option next_comment
  comment 'Synthesis      '
  source lib/techmap/gencomp/tech.in
endmenu

source lib/gaisler/leon3/leon3.in
source lib/grlib/amba/amba.in

mainmenu_option next_comment
comment 'Peripherals             '

  mainmenu_option next_comment
  comment 'On-chip RAM/ROM                 '
    source lib/gaisler/misc/ahbram.in
  endmenu

  mainmenu_option next_comment
  comment 'UARTs, timers and irq control         '
    source lib/gaisler/uart/uart1.in
    source lib/gaisler/irqmp/irqmp.in
    source lib/gaisler/misc/gptimer.in
    source lib/gaisler/misc/grgpio.in
  endmenu

endmenu

mainmenu_option next_comment
comment 'VHDL Debugging        '
  source lib/grlib/util/debug.in
endmenu
```

## designs/leon3-altera-c5ekit/config.in
```kconfig
#
# LEON3 configuration written in linux configuration language
#
# Written by Jiri Gaisler, Gaisler Research
#
# Comments and bug reports to support@gaisler.com
#
#

mainmenu_name "LEON3 Design Configuration"

mainmenu_option next_comment
  comment 'Synthesis      '
  source lib/techmap/gencomp/tech.in
endmenu

#mainmenu_option next_comment
#  comment 'Clock generation'
#  source lib/techmap/clocks/clkgen.in
#endmenu

source lib/gaisler/leon3/leon3.in
source lib/grlib/amba/amba.in

mainmenu_option next_comment
  comment 'Debug Link           '
  source lib/gaisler/uart/dcom.in
  source lib/gaisler/jtag/jtag.in
  source lib/gaisler/net/edcl.in
endmenu

mainmenu_option next_comment
comment 'Peripherals             '

  mainmenu_option next_comment
  comment 'Memory controllers             '
    source lib/gaisler/memctrl/ssrctrl.in
    source lib/gaisler/i2c/i2c.in
  endmenu

  mainmenu_option next_comment
  comment 'On-chip RAM/ROM                 '
    source lib/gaisler/misc/ahbrom.in
    source lib/gaisler/misc/ahbram.in
  endmenu

  mainmenu_option next_comment
  comment 'Ethernet             '
    source lib/gaisler/greth/greth.in
    source lib/gaisler/greth/greth2.in
  endmenu

#  mainmenu_option next_comment
#  comment 'CAN                     '
#    source lib/gaisler/can/can_oc.in
#  endmenu

  mainmenu_option next_comment
  comment 'UARTs, timers and irq control         '
    source lib/gaisler/uart/uart1.in
    source lib/gaisler/irqmp/irqmp.in
    source lib/gaisler/misc/gptimer.in
    source lib/gaisler/misc/grgpio.in
  endmenu


#  mainmenu_option next_comment
#  comment 'Keybord and VGA interface'
#    source lib/gaisler/misc/ps2vga.in
#  endmenu

endmenu

mainmenu_option next_comment
comment 'VHDL Debugging        '
  source lib/grlib/util/debug.in
endmenu
```

## designs/leon3-gr-cpci-xc4v/config.in
```kconfig
#
# LEON3 configuration written in linux configuration language
#
# Written by Jiri Gaisler, Gaisler Research
#
# Comments and bug reports to support@gaisler.com
#
#

#define_bool CONFIG_MCTRL_RMW y

define_bool CONFIG_LEON3FT_PRESENT y
define_bool CONFIG_HAS_SHARED_GRFPU y


mainmenu_name "LEON3MP Design Configuration"

mainmenu_option next_comment
  comment 'Synthesis      '
  source lib/techmap/gencomp/tech.in
  if [ "$CONFIG_SYN_VIRTEX4" = "y" ]; then
    choice 'FPGA type                                      ' \
	  "XC4V-LX100		CONFIG_FPGA_LX100 \
          XC4V-LX160		CONFIG_FPGA_LX160 \
          XC4V-LX200   		CONFIG_FPGA_LX200" XC4V-LX100
  fi
endmenu

mainmenu_option next_comment
  comment 'Clock generation'
  source lib/techmap/clocks/clkgen.in
endmenu

source lib/gaisler/subsys/leon_dsu_stat_base.in
source lib/grlib/amba/amba.in

mainmenu_option next_comment
  comment 'Debug Link           '
  source lib/gaisler/uart/dcom.in
  source lib/gaisler/jtag/jtag.in
  source lib/gaisler/net/edcl.in
endmenu

mainmenu_option next_comment
  comment 'Memory controllers             '
    source lib/esa/memoryctrl/mctrl.in
    source lib/gaisler/memctrl/ftmctrl.in
    source lib/gaisler/memctrl/sdctrl.in
    source lib/gaisler/misc/ahbstat.in
endmenu

mainmenu_option next_comment
comment 'Peripherals             '

  mainmenu_option next_comment
  comment 'On-chip RAM/ROM                 '
    source lib/gaisler/misc/ahbram.in
  endmenu

  mainmenu_option next_comment
  comment 'Ethernet             '
    source lib/gaisler/greth/greth.in
  endmenu

  mainmenu_option next_comment
  comment 'CAN                     '
    source lib/gaisler/can/can_mc.in
  endmenu

  mainmenu_option next_comment
  comment 'Spacewire      '
    source lib/gaisler/spacewire/spacewire.in
  endmenu

  mainmenu_option next_comment
  comment 'PCI              '
    mainmenu_option next_comment
    comment 'GRPCI1         '
    source lib/gaisler/pci/grpci1/pci_target.in
    source lib/gaisler/pci/grpci1/pci_mtf.in
    source lib/gaisler/pci/grpci1/pcidma.in
    source lib/gaisler/pci/grpci1/pci.in
    endmenu
    mainmenu_option next_comment
    comment 'GRPCI2         '
      source lib/gaisler/pci/grpci2/grpci2.in
    endmenu
    source lib/esa/pci/pci_arb.in
    source lib/gaisler/pci/pcitrace/pcitrace.in
  endmenu

  mainmenu_option next_comment
  comment 'UARTs, timers and I/O port         '
    source lib/gaisler/uart/uart1.in
    source lib/gaisler/uart/uart2.in
    source lib/gaisler/irqmp/irqmp.in
    source lib/gaisler/misc/gptimer.in
    source lib/gaisler/misc/grgpio.in
  endmenu
  
  mainmenu_option next_comment
  comment 'Partial Reconfiguration  '
    source lib/testgrouppolito/pr/pr.in
  endmenu

endmenu

mainmenu_option next_comment
comment 'VHDL Debugging        '
  source lib/grlib/util/debug.in
endmenu
```

## designs/leon3-gr-pci-xc5v/config.in
```kconfig
#
# LEON4 configuration written in linux configuration language
#
# Written by Jiri Gaisler, Gaisler Research
#
# Comments and bug reports to support@gaisler.com
#
#

#define_bool CONFIG_MCTRL_RMW y
define_bool CONFIG_HAS_SHARED_GRFPU y

mainmenu_name "LEON4MP Design Configuration"

mainmenu_option next_comment
  comment 'Synthesis      '
  source lib/techmap/gencomp/tech.in
  choice 'FPGA type                                      ' \
	"XC5V-LX50		CONFIG_FPGA_LX50 \
	XC5V-LX85		CONFIG_FPGA_LX85 \
	XC5V-LX110     		CONFIG_FPGA_LX110" XC5V-LX50
endmenu

mainmenu_option next_comment
  comment 'Clock generation'
  source lib/techmap/clocks/clkgen.in
endmenu

source lib/gaisler/subsys/leon_dsu_stat_base.in
source lib/gaisler/l2cache/l2c.in
source lib/grlib/amba/amba.in

mainmenu_option next_comment
  comment 'Debug Link           '
  source lib/gaisler/uart/dcom.in
  source lib/gaisler/jtag/jtag.in
  source lib/gaisler/usb/grusb_dcl.in
  source lib/gaisler/net/edcl.in
endmenu

mainmenu_option next_comment
  comment 'Memory controllers             '
    source lib/gaisler/memctrl/srctrl.in
    source lib/gaisler/memctrl/sdctrl.in
    source lib/esa/memoryctrl/mctrl.in
    source lib/gaisler/memctrl/ftmctrl.in
    source lib/gaisler/misc/ahbstat.in
endmenu

mainmenu_option next_comment
comment 'Peripherals             '

  mainmenu_option next_comment
  comment 'On-chip RAM/ROM                 '
    source lib/gaisler/misc/ahbram.in
  endmenu

  mainmenu_option next_comment
  comment 'Ethernet             '
    source lib/gaisler/greth/greth.in
  endmenu

  mainmenu_option next_comment
  comment 'CAN                     '
    source lib/gaisler/can/can_mc.in
  endmenu

  mainmenu_option next_comment
  comment 'Spacewire      '
    source lib/gaisler/spacewire/spacewire.in
  endmenu

  mainmenu_option next_comment
  comment 'PCI              '
    mainmenu_option next_comment
    comment 'GRPCI2         '
      source lib/gaisler/pci/grpci2/grpci2.in
    endmenu
    source lib/esa/pci/pci_arb.in
  endmenu

  mainmenu_option next_comment
  comment 'USB 2.0 Host Controller      '
    source lib/gaisler/usb/grusbhc.in
  endmenu

  mainmenu_option next_comment
  comment 'USB 2.0 Device Controller      '
    source lib/gaisler/usb/grusbdc.in
  endmenu

  mainmenu_option next_comment
  comment 'UARTs, timers and I/O port         '
    source lib/gaisler/uart/uart1.in
    source lib/gaisler/uart/uart2.in
    source lib/gaisler/irqmp/irqmp.in
    source lib/gaisler/misc/gptimer.in
    source lib/gaisler/misc/grgpio.in
  endmenu

  mainmenu_option next_comment
  comment 'MIL-STD-1553B'
    source lib/gaisler/gr1553b/gr1553b.in
  endmenu

endmenu

mainmenu_option next_comment
comment 'VHDL Debugging        '
  source lib/grlib/util/debug.in
endmenu
```

## designs/leon3-terasic-de0-nano/config.in
```kconfig
#
# LEON3 configuration written in linux configuration language
#
# Written by Jiri Gaisler, Gaisler Research
#
# Comments and bug reports to support@gaisler.com
#
#

#define_bool CONFIG_MCTRL_RMW y
define_bool CONFIG_HAS_SHARED_GRFPU y

mainmenu_name "LEON3MP Design Configuration"

mainmenu_option next_comment
  comment 'Synthesis      '
  source lib/techmap/gencomp/tech.in
endmenu

mainmenu_option next_comment
  comment 'Clock generation'
  source lib/techmap/clocks/clkgen.in
endmenu

source lib/gaisler/leon3/leon3.in
source lib/grlib/amba/amba.in

mainmenu_option next_comment
  comment 'Debug Link           '
  source lib/gaisler/jtag/jtag.in
endmenu

mainmenu_option next_comment
  comment 'Memory controllers             '
    source lib/gaisler/memctrl/sdctrl.in
    source lib/gaisler/misc/ahbstat.in
    source lib/gaisler/spi/spimctrl.in
endmenu

mainmenu_option next_comment
comment 'Peripherals             '

  mainmenu_option next_comment
  comment 'On-chip RAM/ROM                 '
    source lib/gaisler/misc/ahbrom.in
    source lib/gaisler/misc/ahbram.in
  endmenu

  mainmenu_option next_comment
  comment 'UARTs, timers and I/O port         '
    source lib/gaisler/uart/uart1.in
    source lib/gaisler/irqmp/irqmp.in
    source lib/gaisler/misc/gptimer.in
    source lib/gaisler/misc/grgpio.in
    source lib/gaisler/misc/grgpio2.in
  endmenu

  mainmenu_option next_comment
  comment 'I2C master         '
    source lib/gaisler/i2c/i2c.in
  endmenu
  
  source lib/gaisler/spi/spictrl.in

endmenu

mainmenu_option next_comment
comment 'VHDL Debugging        '
  source lib/grlib/util/debug.in
endmenu
```

## designs/leon3-terasic-s5gs-dsp/config.in
```kconfig
#
# LEON3 configuration written in linux configuration language
#
# Written by Jiri Gaisler, Gaisler Research
#
# Comments and bug reports to support@gaisler.com
#
#

#define_bool CONFIG_MCTRL_RMW y
define_bool CONFIG_HAS_SHARED_GRFPU y

mainmenu_name "LEON3MP Design Configuration"

mainmenu_option next_comment
  comment 'Synthesis      '
  source lib/techmap/gencomp/tech.in
endmenu

mainmenu_option next_comment
  comment 'Clock generation'
  source lib/techmap/clocks/clkgen.in
endmenu

source lib/gaisler/leon3/leon3.in
source lib/gaisler/l2cache/l2c.in
source lib/grlib/amba/amba.in

mainmenu_option next_comment
  comment 'Debug Link           '
  source lib/gaisler/jtag/jtag.in
  source lib/gaisler/net/edcl.in
endmenu

mainmenu_option next_comment
  comment 'Memory controllers             '
    source lib/esa/memoryctrl/mctrl.in
    source lib/gaisler/misc/ahbstat.in
endmenu

mainmenu_option next_comment
comment 'Peripherals             '

  mainmenu_option next_comment
  comment 'On-chip RAM/ROM                 '
    source lib/gaisler/misc/ahbram.in
  endmenu

  mainmenu_option next_comment
  comment 'Ethernet             '
    source lib/gaisler/greth/greth.in
  endmenu
  
  mainmenu_option next_comment
  comment 'UARTs, timers and I/O port         '
    source lib/gaisler/uart/uart1.in
    source lib/gaisler/irqmp/irqmp.in
    source lib/gaisler/misc/gptimer.in
    source lib/gaisler/misc/grgpio.in
  endmenu

endmenu

mainmenu_option next_comment
comment 'VHDL Debugging        '
  source lib/grlib/util/debug.in
endmenu
```

## designs/leon3-xilinx-kc705/config.in
```kconfig
#
# LEON4 configuration written in linux configuration language
#
# Written by Fredrik Ringhage, Gaisler Research
#
# Comments and bug reports to ringhage@gaisler.com
#
#

#define_bool CONFIG_MCTRL_RMW y
define_bool CONFIG_HAS_SHARED_GRFPU y

mainmenu_name "LEON4MP Design Configuration"

mainmenu_option next_comment
  comment 'Synthesis      '
  source lib/techmap/gencomp/tech.in
endmenu

mainmenu_option next_comment
  comment 'Clock generation'
  source lib/techmap/clocks/clkgen.in
endmenu

source lib/gaisler/subsys/leon_dsu_stat_base.in
source lib/gaisler/l2cache/l2c.in
source lib/grlib/amba/amba.in

mainmenu_option next_comment
  comment 'Debug Link           '
  source lib/gaisler/uart/dcom.in
  source lib/gaisler/jtag/jtag.in
  source lib/gaisler/net/edcl.in
endmenu

mainmenu_option next_comment
comment 'Peripherals             '

  mainmenu_option next_comment
  comment 'Memory controller             '
    source lib/esa/memoryctrl/mctrl.in
    source lib/gaisler/ddr/mig_7series.in
    source lib/gaisler/misc/ahbstat.in
  endmenu

  mainmenu_option next_comment
  comment 'On-chip RAM/ROM                 '
    source lib/gaisler/misc/ahbrom.in
    source lib/gaisler/misc/ahbram.in
  endmenu

  mainmenu_option next_comment
  comment 'Ethernet             '
    source lib/gaisler/greth/greth.in
  endmenu

  mainmenu_option next_comment
  comment 'UARTs, timers and irq control         '
    source lib/gaisler/uart/uart1.in
    source lib/gaisler/irqmp/irqmp.in
    source lib/gaisler/misc/gptimer.in
    source lib/gaisler/misc/grgpio.in
    source lib/gaisler/i2c/i2c.in
  endmenu

  mainmenu_option next_comment
  comment 'Keybord and VGA interface'
    source lib/gaisler/misc/ps2vga.in
  endmenu

  mainmenu_option next_comment
  comment 'SPI'
    source lib/gaisler/spi/spimctrl.in
  endmenu

endmenu

mainmenu_option next_comment
comment 'VHDL Debugging        '
  source lib/grlib/util/debug.in
endmenu
```

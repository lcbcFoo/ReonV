## designs/leon3-xilinx-ml510/config.in
```kconfig
# LEON3 configuration written in linux configuration language
#
# Written by Jiri Gaisler, Gaisler Research
#
# Comments and bug reports to support@gaisler.com
#
#

#define_bool CONFIG_MCTRL_RMW y
define_bool CONFIG_HAS_SHARED_GRFPU y

mainmenu_name "LEON3MP Design Configuration"

mainmenu_option next_comment
  comment 'Synthesis      '
  source lib/techmap/gencomp/tech.in
  choice 'Target selection                                      ' \
	"Virtex5-QV	CONFIG_DEVICE_XQR5V \
        Virtex5-Commercial		CONFIG_DEVICE_COMMERCIAL" CONFIG_DEVICE_XQR5V
endmenu

mainmenu_option next_comment
  comment 'Clock generation'
  source lib/techmap/clocks/clkgen.in
endmenu

source lib/gaisler/subsys/leon_dsu_stat_base.in
source lib/gaisler/l2cache/l2c.in
source lib/grlib/amba/amba.in

mainmenu_option next_comment
  comment 'Debug Link           '
  source lib/gaisler/uart/dcom.in
  source lib/gaisler/jtag/jtag.in
  source lib/gaisler/net/edcl.in
endmenu

mainmenu_option next_comment
comment 'Peripherals             '

  mainmenu_option next_comment
  comment 'Memory controller             '
    source lib/esa/memoryctrl/mctrl.in
    source lib/gaisler/memctrl/ftmctrl.in
    source lib/gaisler/ddr/ddr2sp.in
    source lib/gaisler/misc/ahbstat.in
  endmenu

  mainmenu_option next_comment
  comment 'On-chip RAM/ROM                 '
    source lib/gaisler/misc/ahbrom.in
    source lib/gaisler/misc/ahbram.in
  endmenu

  mainmenu_option next_comment
  comment 'Ethernet             '
    source lib/gaisler/greth/greth.in
    source lib/gaisler/greth/greth2.in
  endmenu

  mainmenu_option next_comment
  comment 'UART, timer, I/O port, IRQ controller, statistics'
    source lib/gaisler/uart/uart1.in
    source lib/gaisler/irqmp/irqmp.in
    source lib/gaisler/misc/gptimer.in
    source lib/gaisler/misc/grgpio.in
  endmenu

  mainmenu_option next_comment
  comment 'I2C and SPI '
    source lib/gaisler/i2c/i2c.in
    source lib/gaisler/spi/spictrl.in
  endmenu

  mainmenu_option next_comment
  comment 'PCI              '
    mainmenu_option next_comment
    comment 'GRPCI2         '
      source lib/gaisler/pci/grpci2/grpci2.in
    endmenu
    source lib/esa/pci/pci_arb.in
  endmenu

  mainmenu_option next_comment
  comment 'VGA interface'
    source lib/gaisler/misc/svgactrl.in
  endmenu

  mainmenu_option next_comment
  comment 'System ACE and System Monitor'
    source lib/gaisler/misc/gracectrl.in
    source lib/gaisler/misc/grsysmon.in
  endmenu
endmenu

mainmenu_option next_comment
comment 'VHDL Debugging        '
  source lib/grlib/util/debug.in
endmenu
```

## designs/leon3-xilinx-ml605/config.in
```kconfig
#
# LEON3 configuration written in linux configuration language
#
# Written by Jiri Gaisler, Gaisler Research
#
# Comments and bug reports to support@gaisler.com
#
#

#define_bool CONFIG_MCTRL_RMW y
define_bool CONFIG_LEON3FT_PRESENT y
define_bool CONFIG_HAS_SHARED_GRFPU y

mainmenu_name "LEON3MP Design Configuration"

mainmenu_option next_comment
  comment 'Synthesis      '
  source lib/techmap/gencomp/tech.in
endmenu

#mainmenu_option next_comment
#  comment 'Board options'
#    choice 'FPGA type                                      ' \
#	"XC4V-LX25		CONFIG_FPGA_LX25 \
#	XC4V-LX60     		CONFIG_FPGA_LX60" XC4V-LX25
#
#  source lib/techmap/clocks/clkgen.in
#endmenu

mainmenu_option next_comment
  comment 'Clock generation'
  comment 'Clock generator used when MIG is disabled            '
  source lib/techmap/clocks/clkgen.in
    choice 'System clock frequency (with MIG enabled)           ' \
	"60MHz		CONFIG_FREQ60 \
	 75MHz     	CONFIG_FREQ75  \
	 80MHz     	CONFIG_FREQ80  \
	100MHz     	CONFIG_FREQ100 \
	120MHz     	CONFIG_FREQ120" 80MHz
endmenu

source lib/gaisler/leon3/leon3.in
source lib/grlib/amba/amba.in

mainmenu_option next_comment
  comment 'Debug Link           '
  source lib/gaisler/uart/dcom.in
  source lib/gaisler/jtag/jtag.in
  source lib/gaisler/net/edcl.in
endmenu

mainmenu_option next_comment
comment 'Peripherals             '

  mainmenu_option next_comment
  comment 'Memory controllers             '
    source lib/esa/memoryctrl/mctrl.in
    source lib/gaisler/ddr/mig.in
  endmenu

  mainmenu_option next_comment
  comment 'On-chip RAM/ROM                 '
    source lib/gaisler/misc/ahbrom.in
    source lib/gaisler/misc/ahbram.in
  endmenu

  mainmenu_option next_comment
  comment 'Ethernet             '
    source lib/gaisler/greth/greth.in
  endmenu

  mainmenu_option next_comment
  comment 'UARTs, timers, irq control and perf. counters '
    source lib/gaisler/uart/uart1.in
    source lib/gaisler/irqmp/irqmp.in
    source lib/gaisler/misc/gptimer.in
    source lib/gaisler/misc/grgpio.in
    source lib/gaisler/i2c/i2c.in
  endmenu

  mainmenu_option next_comment
  comment 'Keybord and VGA interface'
    source lib/gaisler/misc/ps2vga.in
  endmenu

  mainmenu_option next_comment
  comment 'System ACE Interface Controller'
    source lib/gaisler/misc/gracectrl.in
  endmenu

  mainmenu_option next_comment
  comment 'PCI EXPRESS'
    source lib/gaisler/pcie/pcie.in
  endmenu


endmenu

mainmenu_option next_comment
comment 'VHDL Debugging        '
  source lib/grlib/util/debug.in
endmenu
```

## designs/leon3-ztex-ufm-115/config.in
```kconfig
#
# LEON3 configuration written in linux configuration language
#
# Written by Jiri Gaisler, Gaisler Research
#
# Comments and bug reports to support@gaisler.com
#
#

#define_bool CONFIG_MCTRL_RMW y

mainmenu_name "LEON3 Design Configuration"

mainmenu_option next_comment
  comment 'Synthesis      '
  source lib/techmap/gencomp/tech.in
endmenu

mainmenu_option next_comment
  comment 'Board options'
    choice 'FPGA type                                      ' \
	"XC6S-LX45		CONFIG_FPGA_LX45 \
        XC6S-LX75               CONFIG_FPGA_LX75 \
	XC6S-LX100     		CONFIG_FPGA_LX100 \
        XC6S-LX150              CONFIG_FPGA_LX150" XC6S-LX75
endmenu

mainmenu_option next_comment
  comment 'Clock generation'
  source lib/techmap/clocks/clkgen.in
endmenu

source lib/gaisler/leon3/leon3.in
source lib/grlib/amba/amba.in

mainmenu_option next_comment
  comment 'Debug Link           '
  source lib/gaisler/uart/dcom.in
  source lib/gaisler/jtag/jtag.in
endmenu

mainmenu_option next_comment
comment 'Peripherals             '

  source lib/gaisler/ddr/mig.in

  mainmenu_option next_comment
  comment 'On-chip RAM/ROM                 '
    source lib/gaisler/misc/ahbrom.in
    source lib/gaisler/misc/ahbram.in
  endmenu

  mainmenu_option next_comment
  comment 'UARTs, timers and irq control         '
    source lib/gaisler/uart/uart1.in
    source lib/gaisler/irqmp/irqmp.in
    source lib/gaisler/misc/gptimer.in
    source lib/gaisler/misc/grgpio.in
  endmenu

  source lib/gaisler/spi/spictrl.in

endmenu

mainmenu_option next_comment
comment 'VHDL Debugging        '
  source lib/grlib/util/debug.in
endmenu
```
